## firmware/boards/arm/nicenano_v20/Kconfig.defconfig
```kconfig
# Copyright (c) 2025 MLesniak https://github.com/LesniakM

if BOARD_NICENANO_V20

config BT_CTLR
    bool
    default BT

endif # BOARD_NICENANO_V20
```

## firmware/boards/arm/nicenano_v20/Kconfig.nicenano_v20
```kconfig
# Copyright (c) 2025 MLesniak https://github.com/LesniakM

config BOARD_NICENANO_V20
	select SOC_NRF52840_QIAA
    select ARCH_ARM

config BOARD_ENABLE_DCDC
    bool "Enable DCDC mode"
    select SOC_DCDC_NRF52X
    default y
```
